## drivers/power/supply/qcom/Kconfig
```kconfig
# SPDX-License-Identifier: GPL-2.0-only

menu "Qualcomm Technologies, Inc. Charger and Fuel Gauge support"

config QPNP_SMB5
	tristate "SMB5 Battery Charger"
	depends on MFD_SPMI_PMIC
	help
	  Say Y to enables support for the SMB5 charging peripheral.
	  The QPNP SMB5 charger driver supports the charger peripheral
	  present in the chip.
	  The power supply framework is used to communicate battery and
	  usb properties to userspace and other driver consumers such
	  as fuel gauge, USB, and USB-PD.
	  VBUS and VCONN regulators are registered for supporting OTG,
	  and powered Type-C cables respectively.

config SMB1390_CHARGE_PUMP_PSY
	tristate "SMB1390 power supply framework based driver"
	depends on MFD_I2C_PMIC
	help
	  Say Y to include support for SMB1390 Charge Pump driver based on
	  power supply framework.
	  SMB1390 is a div2 charge pump capable of delivering 6A charge current
	  with very high efficiency. It can work either as 2s to 1s
	  pre-regulator or as a companion charger when paired with Qualcomm
	  Technologies, Inc.’s family of standalone chargers to enable a high
	  current, low profile Li+ battery charging system.

config SMB1355_SLAVE_CHARGER
	tristate "SMB1355 Slave Battery Charger"
	depends on MFD_I2C_PMIC
	help
	  Say Y to include support for SMB1355 Battery Charger.
	  SMB1355 is a single phase 5A battery charger.
	  The driver supports charger enable/disable.
	  The driver reports the charger status via the power supply framework.
	  A charger status change triggers an IRQ via the device STAT pin.

config QPNP_QNOVO5
	bool "QPNP QNOVO5 driver"
	depends on MFD_SPMI_PMIC
	help
	  Say Y here to enable the Qnovo5 PBS-based pulse charging engine.
	  Qnovo5 driver accepts pulse parameters via sysfs entries and programs
	  the hardware module. It also allows userspace code to read diagnostics
	  of voltage and current measured during certain phases of the pulses.

config QPNP_FG_GEN4
	tristate "QPNP GEN4 fuel gauge driver"
	depends on MFD_SPMI_PMIC
	help
	  Say Y here to enable the GEN4 Fuel Gauge driver. This adds support
	  for battery fuel gauging and state of charge of battery connected to
	  the device that has QTI PMICs like PM8150B. The state of charge is
	  reported through a BMS power supply property and also sends uevents
	  when the capacity is updated.

config QPNP_QG
	bool "QPNP Qgauge driver"
	depends on MFD_SPMI_PMIC
	help
	  Say Y here to enable the Qualcomm Technologies, Inc. QGauge driver
	  which uses the periodic sampling of the battery voltage and current
	  to determine the battery state-of-charge (SOC) and supports other
	  battery management features.

config STM32l011X4
	tristate "STM32l011X4 driver"
	depends on I2C
	default n
	help
	  Say Y here to enable support for STM32l011X4.

config BATTERY_BQ27750
	tristate "BQ27750 battery driver"
	depends on I2C
	help
		Say Y here to enable support for batteries with BQ28Z61 (I2C) chips.
		The BQ28Z61 Texas Instruments Inc device monitors the battery
		charging/discharging status via Rsens resistor, typically 10 mohm.
		It monitors the battery temperature via Thermistor.
		The device monitors the battery level (Relative-State-Of-Charge).
		The device is SBS compliant, providing battery info over I2C.

config BATTERY_DETECT
	bool "battery protect"
	help
	  Say Y here to enable.

config FUEL_SUMMARY
	tristate "VIVO FUEL SUMMARY"
	help
	  Say Y to enable support for the FUEL SUMMARY

config HL6111R
	bool "HL6111R driver"
	depends on I2C && OF
	select REGMAP_I2C
	help
	  Say Y here to enable the Halo Microelectronics HL6111R driver.
	  HL6111R is a wireless charging power receiver IC that supports the
	  A4WP wireless charging power delivery standard. It supports up to
	  15W, and the output voltage can be programmed with variable step
	  sizes. The HL6111R has voltage, current and temperature
	  protection mechanisms, an I2C interface, and a PSNS output.

endmenu
```
